#include <stdarg.h>
#include <stdio.h>
#include <string.h>
#include <aos/aos.h>
#include <hal/soc/uart.h>
#include "modbus_protocol.h"

static uart_dev_t *modbus_uart;

static aos_mutex_t modbus_res_lock;

static unsigned short modbus_byte_time; /* one byte time in ms */

static const unsigned char crc_high[] = {
    0x00, 0xC1, 0x81, 0x40, 0x01, 0xC0, 0x80, 0x41, 0x01, 0xC0, 0x80, 0x41,
    0x00, 0xC1, 0x81, 0x40, 0x01, 0xC0, 0x80, 0x41, 0x00, 0xC1, 0x81, 0x40,
    0x00, 0xC1, 0x81, 0x40, 0x01, 0xC0, 0x80, 0x41, 0x01, 0xC0, 0x80, 0x41,
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    0x00, 0xC1, 0x81, 0x40
};

static const unsigned char crc_low[] = {
    0x00, 0xC0, 0xC1, 0x01, 0xC3, 0x03, 0x02, 0xC2, 0xC6, 0x06, 0x07, 0xC7,
    0x05, 0xC5, 0xC4, 0x04, 0xCC, 0x0C, 0x0D, 0xCD, 0x0F, 0xCF, 0xCE, 0x0E,
    0x0A, 0xCA, 0xCB, 0x0B, 0xC9, 0x09, 0x08, 0xC8, 0xD8, 0x18, 0x19, 0xD9,
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    0x41, 0x81, 0x80, 0x40
};

static unsigned short modbus_crc_calc(unsigned char *buff, unsigned short len)
{
	unsigned char high = 0xff;
	unsigned char low = 0xff;
	int idx = 0;

    while (len--) {
        idx = low ^ *(buff++);
        low = (unsigned char)(high ^ crc_high[idx]);
        high = crc_low[idx];
    }
    return (unsigned short)(high << 8 | low);
}


static int modbus_uart_send(uint8_t *pdata, uint16_t size)
{
	uart_dev_t *uart = modbus_uart;
    if (!uart || !pdata)
        return -ENODEV;
	return HAL_UART_Transmit_IT(uart->priv, pdata, size);
}

static int modbus_uart_recv(uint8_t *pdata, uint16_t size, unsigned int timeout)
{
	uart_dev_t *uart = modbus_uart;
	int recv_size = 0;

    if (!uart || !pdata)
        return -ENODEV;

	hal_uart_recv_II(uart, pdata, size, &recv_size, timeout);
	return recv_size;
}

int modbus_read(unsigned char *buff, unsigned char slave,
	unsigned short addr, unsigned short count, unsigned short response_time)
{
	int rc = 0;

	if (aos_mutex_lock(&modbus_res_lock, AOS_WAIT_FOREVER)) {
		LOG("request modbus lock failed !\n");
		return -EPERM;
	}
       unsigned int datalen = count*2;
	unsigned char send_buff[8];
	send_buff[0] = slave;
	send_buff[1] = 0x03; //function code
	send_buff[2] = (addr >> 8) & 0xff;
	send_buff[3] = addr & 0xff;
	send_buff[4] = (count >> 8) & 0xff;
	send_buff[5] = count & 0xff;

	unsigned short crc16 = modbus_crc_calc(send_buff, 6);
	send_buff[6] = (unsigned char)(crc16 & 0xff);
	send_buff[7] = (unsigned char)(crc16 >> 8);

	modbus_uart_send(send_buff, 8);
        printf("yftest send_buff\n");
        for(int m=0;m<8;m++) printf(" %d \n",send_buff[m]);
        printf("yftest send_buff\n");
	unsigned short recv_size = datalen + 5; /* actual uart packet size in bytes */
	//unsigned char recv_buff[SNS_VALUE_BYTES_MAX + 5];
	unsigned char recv_buff[recv_size];
	memset(recv_buff, 0, sizeof(recv_buff));

	unsigned int timeout_ms = modbus_byte_time * (recv_size + 8) + response_time;
	rc = modbus_uart_recv(recv_buff, recv_size, timeout_ms);
        printf("yftest recv_buff\n");
        for(int m=0;m<rc;m++) printf(" %d \n",recv_buff[m]);
        printf("yftest recv_buff\n");
	if (rc != recv_size)
		LOG("%s: receive size %u is incorrect !rc=%d.\n", __func__, recv_size,rc);

	aos_mutex_unlock(&modbus_res_lock);

	if (recv_buff[0] != slave) {
		LOG("%s: response slave 0x%02x is not expected 0x%02x !\n",
			__func__, recv_buff[0], slave);
		return -EIO;
	}

	memcpy(buff, recv_buff + 3, datalen);
	return rc;
}

void modbus_uart_init(uint8_t port_id, uint32_t rate)
{
	uart_dev_t *uart = NULL;
	uart = malloc(sizeof(uart_dev_t));
	if (!uart) {
		LOG("alloc uart_dev_t failed !\n");
		return;
	}
    uart->port = port_id;
    uart->config.baud_rate = rate;
    uart->config.data_width = DATA_WIDTH_8BIT;
    uart->config.flow_control = FLOW_CONTROL_DISABLED;
    uart->config.mode = MODE_TX_RX;
    uart->config.parity = NO_PARITY;
    uart->config.stop_bits = STOP_BITS_1;

	if (hal_uart_init(uart) != 0) {
		LOG("init modbus uart failed !\n");
		free(uart);
		uart = NULL;
		return;
	}

	unsigned int time_us = ((8 + 1 + (uart->config.stop_bits + 1)) * 1000000) / uart->config.baud_rate;
	if ((time_us % 1000) >= 500)
		modbus_byte_time = time_us / 1000 + 1;
	else
		modbus_byte_time = time_us / 1000;

	modbus_uart = uart;
    
    aos_mutex_new(&modbus_res_lock);
}


